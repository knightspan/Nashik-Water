/*
  Smart Water Quality Monitoring – Arduino UNO sensor node   (firmware v2)

  Sensors : pH probe + PH-4502C board (A0), TDS board (A1), turbidity board (A2),
            DS18B20 waterproof probe (D2, 4.7 kΩ pull-up to 5 V)
  Outputs : green / yellow / red LEDs (D9 / D10 / D11, 220 Ω), active buzzer (D8)
  Link    : SoftwareSerial to NodeMCU ESP8266 (UNO D7 = RX from ESP TX,
            UNO D6 = TX to ESP RX through a 1 kΩ / 2 kΩ divider), 9600 baud
  Every minute: read and calibrate all sensors, send one JSON line to the ESP8266 and USB.
  Every 5 min : median of the 5 readings -> on-board decision tree -> LEDs/buzzer
                (works with no Wi-Fi at all — the offline safety net).

  Files: WaterStateTree.h and SiteBaseline.h are generated by `python -m wqm_ml.train`
         (copy them from ml/models/). Libraries: OneWire, DallasTemperature.
  Calibrate first with firmware/calibration/calibration.ino (see docs/HARDWARE.md).

  Changes from v1: 5-minute window is a median (same as the Pi and the training data),
  the tree and baseline headers come from the training pipeline, and a failed
  DS18B20 read is reported as temp_ok:0 so the Pi ignores that temperature.
*/
#include <OneWire.h>
#include <DallasTemperature.h>
#include <SoftwareSerial.h>
#include "WaterStateTree.h"   // generated: depth-5 tree on 6 features
#include "SiteBaseline.h"     // generated: BASE_PH, BASE_TDS, BASE_TURB

// ---------------- pins ----------------
const uint8_t PIN_PH = A0, PIN_TDS = A1, PIN_TURB = A2, PIN_TEMP = 2;
const uint8_t LED_GREEN = 9, LED_YELLOW = 10, LED_RED = 11, BUZZER = 8;
SoftwareSerial esp(7, 6);
OneWire oneWire(PIN_TEMP);
DallasTemperature ds(&oneWire);
Eloquent::ML::Port::WaterStateTree tree;

// ---------------- calibration: replace with YOUR values from calibration.ino ----------------
const char* NODE_ID = "node_01";      // mapped to "ramkund" on the Pi (NODE_SITE_MAP)
float PH_V7 = 2.50, PH_V4 = 3.03;     // board volts in pH 7.00 and pH 4.01 buffers (at ~25 °C)
float TDS_K = 1.00;                   // known TDS / measured TDS with a standard solution
float TURB_VCLEAR = 4.20;             // board volts in clear (RO / distilled) water
const float VREF = 5.0;               // measure the UNO's 5 V pin with a multimeter and enter it

const unsigned long SAMPLE_MS = 60000UL;   // one reading per minute
float winPh[5], winTds[5], winTurb[5]; uint8_t nWin = 0;
float histPh[4], histTds[4], histTurb[4]; uint8_t nHist = 0;  // last 4 window medians
int state = 0;                                                 // 0 normal, 1 natural, 2 alert

float readVolts(uint8_t pin) {          // median of 15 ADC samples removes spikes
  int v[15];
  for (int i = 0; i < 15; i++) { v[i] = analogRead(pin); delay(10); }
  for (int i = 0; i < 14; i++) for (int j = i + 1; j < 15; j++) if (v[j] < v[i]) { int t = v[i]; v[i] = v[j]; v[j] = t; }
  return v[7] * VREF / 1023.0;
}

float median5(float* a) {
  float b[5]; for (int i = 0; i < 5; i++) b[i] = a[i];
  for (int i = 0; i < 4; i++) for (int j = i + 1; j < 5; j++) if (b[j] < b[i]) { float t = b[i]; b[i] = b[j]; b[j] = t; }
  return b[2];
}

float toPH(float v, float t) {
  float slope = (PH_V7 - PH_V4) / (7.00 - 4.01);        // volts per pH unit (negative on PH-4502C)
  slope *= (273.15 + t) / 298.15;                        // Nernst temperature correction
  return constrain(7.0 + (v - PH_V7) / slope, 0.0, 14.0);
}
float toTDS(float v, float t) {
  float vc = v / (1.0 + 0.02 * (t - 25.0));              // compensate to 25 °C
  float ppm = (133.42 * vc * vc * vc - 255.86 * vc * vc + 857.39 * vc) * 0.5;
  return constrain(ppm * TDS_K, 0.0, 2000.0);
}
float toNTU(float v) {
  v = v * (4.2 / TURB_VCLEAR);                           // scale so clear water reads 4.2 V
  if (v >= 4.2) return 0.0;
  if (v <= 2.56) return 3000.0;                          // curve peaks at 2.56 V; below it, saturated
  float ntu = -1120.4 * v * v + 5742.3 * v - 4352.9;
  return constrain(ntu, 0.0, 3000.0);
}

void setLEDs(int s) {
  digitalWrite(LED_GREEN, s == 0); digitalWrite(LED_YELLOW, s == 1); digitalWrite(LED_RED, s == 2);
  if (s == 2) { for (int i = 0; i < 3; i++) { digitalWrite(BUZZER, HIGH); delay(200); digitalWrite(BUZZER, LOW); delay(150); } }
}

void runTree() {                         // every 5 minutes
  float ph = median5(winPh), tds = median5(winTds), turb = median5(winTurb);
  nWin = 0;
  for (int i = 3; i > 0; i--) { histPh[i] = histPh[i-1]; histTds[i] = histTds[i-1]; histTurb[i] = histTurb[i-1]; }
  histPh[0] = ph; histTds[0] = tds; histTurb[0] = turb;
  if (nHist < 4) { nHist++; return; }    // need 15 min of history for the change features
  float x[6] = {                         // order = ARDUINO_FEATURES in ml/wqm_ml/features.py
    ph - BASE_PH, tds / BASE_TDS, (turb + 0.5) / (BASE_TURB + 0.5),   // rel_ph, rel_tds, rel_turb
    tds - histTds[3], turb - histTurb[3], ph - histPh[3]               // d3_tds, d3_turb, d3_ph
  };
  int s = tree.predict(x);
  if (s != state) { state = s; setLEDs(state); }
}

void setup() {
  Serial.begin(9600); esp.begin(9600); ds.begin();
  ds.setResolution(12);
  pinMode(LED_GREEN, OUTPUT); pinMode(LED_YELLOW, OUTPUT); pinMode(LED_RED, OUTPUT); pinMode(BUZZER, OUTPUT);
  for (int s = 0; s < 3; s++) { setLEDs(s == 2 ? 1 : s); delay(300); }  // lamp test (no beep)
  setLEDs(0);
  Serial.println(F("WQ_NODE_READY v2"));
}

unsigned long last = 0;
void loop() {
  if (last != 0 && millis() - last < SAMPLE_MS) return;
  last = millis();

  ds.requestTemperatures();
  float t = ds.getTempCByIndex(0);
  bool tOk = (t > -50 && t != 85.0 && t != DEVICE_DISCONNECTED_C);
  float tc = tOk ? t : 25.0;             // compensate at 25 °C if the probe failed

  float vPh = readVolts(PIN_PH);
  delay(1000);                            // keep the TDS excitation away from the pH reading
  float vTds = readVolts(PIN_TDS), vTurb = readVolts(PIN_TURB);
  float ph = toPH(vPh, tc), tds = toTDS(vTds, tc), ntu = toNTU(vTurb);

  winPh[nWin] = ph; winTds[nWin] = tds; winTurb[nWin] = ntu;
  if (++nWin >= 5) runTree();

  char line[200], a[10], b[10], c[10], d[10];
  dtostrf(ph, 1, 2, a); dtostrf(tds, 1, 1, b); dtostrf(ntu, 1, 1, c); dtostrf(tc, 1, 2, d);
  snprintf(line, sizeof(line),
    "{\"node\":\"%s\",\"ph\":%s,\"tds\":%s,\"turb\":%s,\"temp\":%s,\"temp_ok\":%d,\"edge_state\":%d}",
    NODE_ID, a, b, c, d, tOk, state);
  Serial.println(line);                   // USB: serial_logger.py / edge_ai.py --serial
  esp.println(line);                      // NodeMCU -> MQTT (Pi) + ThingSpeak
}
