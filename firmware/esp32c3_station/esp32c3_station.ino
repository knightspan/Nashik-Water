/*
  Smart Water Quality Monitoring – ESP32-C3 sensor station   (firmware v3)

  One station per water body. Sensors -> ESP32-C3 -> Wi-Fi -> HTTPS -> cloud API -> website.
  No Arduino, no gateway, no Raspberry Pi and no PC in the data path.

  Every READ_INTERVAL_S (10 s): read the sensors (median of 21 ADC samples each), decide a
  colour, and POST one record to  <API_URL>/api/ingest/batch  with the X-API-Key header.
  Every 5 min: median of that window -> on-board decision tree (same tree and features as
  the Arduino v2 node, generated by ml/wqm_ml/train.py) -> GREEN / AMBER / RED.

  Verdict
    pH missing or outside 2-12             -> GREY  Sensor check
    pH + TDS + turbidity, tree warmed up   -> tree: Normal / Natural change / Contamination
    otherwise (e.g. pH probe only)         -> BIS IS 10500 rule: pH 6.5-8.5 Normal, else
                                              Natural change (never RED from pH alone)

  Offline: readings are kept in RAM (last 360 = 1 hour at 10 s) and sent as a batch when
  the Wi-Fi or the server is back. The LEDs/buzzer keep working with no network at all.

  Serial Monitor (115200): shows every reading. Type  cal  + Enter for calibration mode
  (prints sensor volts every second, stops posting), type  run  to go back.

  Setup
    1. Arduino IDE -> Boards Manager -> "esp32 by Espressif Systems" (3.x).
       Board: "ESP32C3 Dev Module" (Super Mini) or "LOLIN C3 Mini".
       Tools -> USB CDC On Boot: Enabled   (otherwise the Serial Monitor stays empty)
    2. Library Manager: OneWire, DallasTemperature (only needed with HAS_TEMP 1, but the
       sketch always includes them).
    3. Copy config.example.h to config.h and fill in Wi-Fi, API key and SITE_ID.
    4. Wiring and calibration: docs/HARDWARE.md.
*/
#include <WiFi.h>
#include <WiFiMulti.h>
#include <WiFiClientSecure.h>
#include <HTTPClient.h>
#include <OneWire.h>
#include <DallasTemperature.h>
#include <time.h>
#include "config.h"           // your settings (copy from config.example.h)
#include "RootCA.h"           // HTTPS root certificates
#include "WaterStateTree.h"   // generated: depth-5 tree on 6 features (copy of ml/models/)

// ---------------------------------------------------------------- constants
static const char* COLOURS[] = {"GREEN", "AMBER", "RED", "GREY"};
static const char* LABELS[]  = {"Normal", "Natural change", "Contamination", "Sensor check"};
static const char* HEALTHS[] = {"ok", "offline", "flatline", "out_of_range"};
enum { C_GREEN, C_AMBER, C_RED, C_GREY };
enum { H_OK, H_OFFLINE, H_FLATLINE, H_OUT_OF_RANGE };

const uint32_t WINDOW_S = 300;                 // 5-minute window, same as the training data
const int READS_PER_WINDOW = WINDOW_S / READ_INTERVAL_S;
const int MAX_WIN = 64;                        // room for READ_INTERVAL_S down to 5 s
const int QUEUE_LEN = 360;                     // 1 hour of 10-second readings
const int BATCH_MAX = 30;                      // records per HTTPS request
const uint32_t WIFI_RESTART_MS = 10UL * 60 * 1000;   // reboot if Wi-Fi is gone this long

// ---------------------------------------------------------------- state
struct Rec {
  time_t ts;                // 0 = clock not set yet (server time is used)
  float ph, tds, turb, temp, wqi;   // NAN = not measured
  uint8_t colour, label, health;
};

WiFiMulti wifiMulti;
OneWire oneWire(PIN_TEMP);
DallasTemperature ds(&oneWire);
Eloquent::ML::Port::WaterStateTree tree;

Rec outbox[QUEUE_LEN];
int qHead = 0, qCount = 0;                     // ring buffer of unsent records

float winPh[MAX_WIN], winTds[MAX_WIN], winTurb[MAX_WIN];
int nPh = 0, nTds = 0, nTurb = 0, nReads = 0;
float histPh[4], histTds[4], histTurb[4];
int nHist = 0;
int treeState = -1;                            // -1 = not warmed up yet

bool calMode = false, keyRejected = false;
uint32_t lastRead = 0, lastCal = 0, wifiLostAt = 0, retryAfter = 0;
String serialLine;

// ---------------------------------------------------------------- helpers
float medianOf(float* a, int n) {
  float b[MAX_WIN];
  for (int i = 0; i < n; i++) b[i] = a[i];
  for (int i = 1; i < n; i++) {                // insertion sort
    float v = b[i]; int j = i - 1;
    while (j >= 0 && b[j] > v) { b[j + 1] = b[j]; j--; }
    b[j + 1] = v;
  }
  return n % 2 ? b[n / 2] : 0.5f * (b[n / 2 - 1] + b[n / 2]);
}

// Sensor-board volts: median of 21 calibrated ADC readings, divider undone.
float readVolts(int pin, float divider) {
  float mv[21];
  for (int i = 0; i < 21; i++) { mv[i] = analogReadMilliVolts(pin); delay(4); }
  return medianOf(mv, 21) / 1000.0f * divider;
}

float toPH(float v, float t) {
  float slope = (PH_V7 - PH_V4) / (7.00f - 4.01f);       // volts per pH unit (either sign)
  slope *= (273.15f + t) / 298.15f;                       // Nernst temperature correction
  return 7.0f + (v - PH_V7) / slope;
}
float toTDS(float v, float t) {
  float vc = v / (1.0f + 0.02f * (t - 25.0f));            // compensate to 25 °C
  float ppm = (133.42f * vc * vc * vc - 255.86f * vc * vc + 857.39f * vc) * 0.5f;
  return constrain(ppm * TDS_K, 0.0f, 2000.0f);
}
float toNTU(float v) {
  v = v * (4.2f / TURB_VCLEAR);                           // scale so clear water reads 4.2 V
  if (v >= 4.2f) return 0.0f;
  if (v <= 2.56f) return 3000.0f;                         // curve peaks at 2.56 V; saturated below
  return constrain(-1120.4f * v * v + 5742.3f * v - 4352.9f, 0.0f, 3000.0f);
}
float wqi(float ph, float tds, float turb) {              // same formula as the API and the Pi
  const float wPh = 0.3680f, wTds = 0.0063f, wTurb = 0.6258f;
  float qPh = ph >= 7.0f ? 100.0f * (ph - 7.0f) / 1.5f : 100.0f * (7.0f - ph) / 0.5f;
  return wPh * qPh + wTds * 100.0f * tds / 500.0f + wTurb * 100.0f * turb / 5.0f;
}

void setPin(int pin, bool on) { if (pin >= 0) digitalWrite(pin, on ? HIGH : LOW); }
void statusLed(bool on) { if (PIN_STATUS_LED >= 0) digitalWrite(PIN_STATUS_LED, on ? LOW : HIGH); }

void showColour(int c) {
  static int shown = -1;
  setPin(PIN_LED_GREEN, c == C_GREEN);
  setPin(PIN_LED_AMBER, c == C_AMBER || c == C_GREY);
  setPin(PIN_LED_RED, c == C_RED);
  if (c == C_RED && shown != C_RED && PIN_BUZZER >= 0) {  // beep once when RED starts
    for (int i = 0; i < 3; i++) { setPin(PIN_BUZZER, true); delay(200); setPin(PIN_BUZZER, false); delay(150); }
  }
  shown = c;
}

bool clockSet() { return time(nullptr) > 1700000000; }   // after Nov 2023 = NTP worked

// ---------------------------------------------------------------- 5-minute tree
void closeWindow() {
  bool full = HAS_TDS && HAS_TURB && nPh && nTds && nTurb;
  if (full) {
    float ph = medianOf(winPh, nPh), tds = medianOf(winTds, nTds), turb = medianOf(winTurb, nTurb);
    for (int i = 3; i > 0; i--) { histPh[i] = histPh[i - 1]; histTds[i] = histTds[i - 1]; histTurb[i] = histTurb[i - 1]; }
    histPh[0] = ph; histTds[0] = tds; histTurb[0] = turb;
    if (nHist < 4) nHist++;                    // 15 min of history needed for the change features
    else {
      float x[6] = {                           // order = ARDUINO_FEATURES in ml/wqm_ml/features.py
        ph - BASE_PH, tds / BASE_TDS, (turb + 0.5f) / (BASE_TURB + 0.5f),
        tds - histTds[3], turb - histTurb[3], ph - histPh[3]
      };
      treeState = tree.predict(x);             // 0 normal, 1 natural change, 2 contamination
    }
  } else {
    nHist = 0; treeState = -1;                 // a sensor dropped out: warm up again
  }
  nPh = nTds = nTurb = nReads = 0;
}

// ---------------------------------------------------------------- one reading
Rec takeReading() {
  Rec r; r.ts = clockSet() ? time(nullptr) : 0;
  r.ph = r.tds = r.turb = r.temp = r.wqi = NAN;
  r.health = H_OK;

  float tc = 25.0f;
  if (HAS_TEMP) {
    ds.requestTemperatures();
    float t = ds.getTempCByIndex(0);
    if (t > -50 && t != 85.0f && t != DEVICE_DISCONNECTED_C) { r.temp = t; tc = t; }
  }
  float ph = toPH(readVolts(PIN_PH, DIV_PH), tc);
  if (ph >= 2.0f && ph <= 12.0f) r.ph = ph;
  if (HAS_TDS) { delay(200); r.tds = toTDS(readVolts(PIN_TDS, DIV_TDS), tc); }
  if (HAS_TURB) r.turb = toNTU(readVolts(PIN_TURB, DIV_TURB));
  if (!isnan(r.ph) && !isnan(r.tds) && !isnan(r.turb)) r.wqi = wqi(r.ph, r.tds, r.turb);

  // 5-minute window for the tree
  if (!isnan(r.ph) && nPh < MAX_WIN) winPh[nPh++] = r.ph;
  if (!isnan(r.tds) && nTds < MAX_WIN) winTds[nTds++] = r.tds;
  if (!isnan(r.turb) && nTurb < MAX_WIN) winTurb[nTurb++] = r.turb;
  if (++nReads >= READS_PER_WINDOW) closeWindow();

  // verdict
  if (isnan(r.ph)) {
    r.colour = C_GREY; r.label = 3; r.health = H_OUT_OF_RANGE;
  } else if (treeState >= 0) {
    r.colour = treeState; r.label = treeState;            // tree classes map 1:1 to colours
  } else if (r.ph >= 6.5f && r.ph <= 8.5f) {
    r.colour = C_GREEN; r.label = 0;
  } else {
    r.colour = C_AMBER; r.label = 1;
  }
  return r;
}

// ---------------------------------------------------------------- queue + HTTPS
void enqueue(const Rec& r) {
  int idx = (qHead + qCount) % QUEUE_LEN;
  if (qCount == QUEUE_LEN) qHead = (qHead + 1) % QUEUE_LEN;   // full: drop the oldest
  else qCount++;
  outbox[idx] = r;
}

void addNum(String& s, const char* key, float v, int digits) {
  s += ",\""; s += key; s += "\":";
  if (isnan(v)) s += "null"; else s += String(v, digits);
}

void addRecord(String& s, const Rec& r) {
  s += "{\"source\":\""; s += SITE_ID;
  s += "\",\"colour\":\""; s += COLOURS[r.colour];
  s += "\",\"label\":\""; s += LABELS[r.label];
  s += "\",\"health\":\""; s += HEALTHS[r.health];
  s += "\",\"synthetic\":false,\"confidence\":null";
  addNum(s, "ph", r.ph, 2); addNum(s, "tds", r.tds, 1); addNum(s, "turb", r.turb, 1);
  addNum(s, "temp", r.temp, 2); addNum(s, "wqi", r.wqi, 1);
  if (r.ts) {
    char buf[32]; struct tm t;
    gmtime_r(&r.ts, &t);   strftime(buf, sizeof buf, "%Y-%m-%dT%H:%M:%SZ", &t);
    s += ",\"ts\":\""; s += buf;
    localtime_r(&r.ts, &t); strftime(buf, sizeof buf, "%Y-%m-%d %H:%M:%S", &t);
    s += "\",\"updated\":\""; s += buf; s += "\"";
  }
  s += "}";
}

// Sends up to BATCH_MAX queued records. Returns a short status for the log line.
String postBatch() {
  if (WiFi.status() != WL_CONNECTED) return "no Wi-Fi, queued";
  if (millis() < retryAfter) return "waiting to retry";
  int n = min(qCount, BATCH_MAX);
  String body; body.reserve(n * 260 + 4);
  body += "[";
  for (int i = 0; i < n; i++) { if (i) body += ","; addRecord(body, outbox[(qHead + i) % QUEUE_LEN]); }
  body += "]";

  WiFiClientSecure tls; tls.setCACert(ROOT_CAS);
  HTTPClient http;
  http.setConnectTimeout(15000);
  http.setTimeout(30000);                      // the free Render server can take ~50 s to wake
  String url = String(API_URL) + "/api/ingest/batch";
  if (!http.begin(tls, url)) return "bad API_URL";
  http.addHeader("Content-Type", "application/json");
  http.addHeader("X-API-Key", API_KEY);
  uint32_t t0 = millis();
  int code = http.POST(body);
  String reply = code > 0 ? http.getString() : http.errorToString(code);
  http.end();
  uint32_t ms = millis() - t0;

  if (code == 201 || code == 200) {            // stored (duplicates also count as done)
    qHead = (qHead + n) % QUEUE_LEN; qCount -= n; keyRejected = false;
    return "sent " + String(n) + " (" + String(ms) + " ms)";
  }
  if (code == 401) { keyRejected = true; retryAfter = millis() + 60000; return "API KEY REJECTED - check API_KEY in config.h"; }
  if (code == 404 || code == 422) {            // unknown SITE_ID or invalid data: retrying won't help
    qHead = (qHead + n) % QUEUE_LEN; qCount -= n;
    return "rejected " + String(code) + ": " + reply.substring(0, 160);
  }
  retryAfter = millis() + (code == 429 ? 30000 : 5000);
  return "server " + String(code) + " " + reply.substring(0, 80) + " - kept " + String(qCount);
}

// ---------------------------------------------------------------- Wi-Fi
void maintainWifi() {
  static uint32_t lastTry = 0;
  if (WiFi.status() == WL_CONNECTED) {
    if (wifiLostAt) {
      Serial.printf("Wi-Fi connected: %s  %s  RSSI %d dBm\n", WiFi.SSID().c_str(),
                    WiFi.localIP().toString().c_str(), WiFi.RSSI());
      wifiLostAt = 0;
    }
    return;
  }
  if (!wifiLostAt) wifiLostAt = millis() | 1;
  if (millis() - wifiLostAt > WIFI_RESTART_MS) { Serial.println("No Wi-Fi for 10 min - restarting"); ESP.restart(); }
  if (millis() - lastTry < 5000) return;
  lastTry = millis();
  wifiMulti.run(8000);                         // joins the strongest configured network
#if WIFI_LOW_TX_POWER
  WiFi.setTxPower(WIFI_POWER_8_5dBm);
#endif
}

// ---------------------------------------------------------------- serial commands
void handleSerial() {
  while (Serial.available()) {
    char ch = Serial.read();
    if (ch != '\n' && ch != '\r') { if (serialLine.length() < 20) serialLine += ch; continue; }
    serialLine.trim(); serialLine.toLowerCase();
    if (serialLine == "cal") { calMode = true; Serial.println("CALIBRATION MODE: posting paused. Type 'run' to resume."); }
    else if (serialLine == "run") { calMode = false; Serial.println("Back to normal mode."); }
    serialLine = "";
  }
}

void printCalibration() {
  float tc = 25.0f;
  if (HAS_TEMP) { ds.requestTemperatures(); float t = ds.getTempCByIndex(0); if (t > -50 && t != 85.0f) tc = t; }
  float vPh = readVolts(PIN_PH, DIV_PH);
  Serial.printf("CAL  pH board %.3f V (pH %.2f)", vPh, toPH(vPh, tc));
  if (HAS_TDS)  { float v = readVolts(PIN_TDS, DIV_TDS);  Serial.printf("  TDS board %.3f V (%.0f mg/L)", v, toTDS(v, tc)); }
  if (HAS_TURB) { float v = readVolts(PIN_TURB, DIV_TURB); Serial.printf("  turbidity board %.3f V (%.1f NTU)", v, toNTU(v)); }
  if (HAS_TEMP) Serial.printf("  temp %.2f C", tc);
  Serial.println();
}

// ---------------------------------------------------------------- setup / loop
void setup() {
  Serial.begin(115200);
  for (uint32_t t0 = millis(); !Serial && millis() - t0 < 2000;) delay(10);
  for (int p : {PIN_STATUS_LED, PIN_LED_GREEN, PIN_LED_AMBER, PIN_LED_RED, PIN_BUZZER}) if (p >= 0) pinMode(p, OUTPUT);
  statusLed(false);
  for (int p : {PIN_LED_GREEN, PIN_LED_AMBER, PIN_LED_RED}) { setPin(p, true); delay(300); setPin(p, false); }   // lamp test
  showColour(C_GREY);

  analogReadResolution(12);
  analogSetAttenuation(ADC_11db);              // 0 to ~2.5 V on the ESP32-C3
  if (HAS_TEMP) { ds.begin(); ds.setResolution(12); }

  WiFi.mode(WIFI_STA);
  WiFi.setAutoReconnect(true);
#if WIFI_LOW_TX_POWER
  WiFi.setTxPower(WIFI_POWER_8_5dBm);
#endif
  if (strlen(WIFI_SSID_1)) wifiMulti.addAP(WIFI_SSID_1, WIFI_PASS_1);
  if (strlen(WIFI_SSID_2)) wifiMulti.addAP(WIFI_SSID_2, WIFI_PASS_2);
  if (strlen(WIFI_SSID_3)) wifiMulti.addAP(WIFI_SSID_3, WIFI_PASS_3);
  configTzTime("IST-5:30", "pool.ntp.org", "time.google.com");   // UTC for ts, IST for 'updated'

  Serial.printf("\nWQ station v3  site '%s'  ->  %s  every %lu s\n", SITE_ID, API_URL, (unsigned long)READ_INTERVAL_S);
  Serial.printf("Sensors: pH%s%s%s\n", HAS_TDS ? " + TDS" : "", HAS_TURB ? " + turbidity" : "", HAS_TEMP ? " + DS18B20" : "");
  wifiLostAt = millis() | 1;
  maintainWifi();
}

void loop() {
  handleSerial();
  maintainWifi();

  if (calMode) {
    if (millis() - lastCal >= 1000) { lastCal = millis(); printCalibration(); }
    return;
  }

  if (lastRead == 0 || millis() - lastRead >= READ_INTERVAL_S * 1000UL) {
    lastRead = millis();
    Rec r = takeReading();
    showColour(r.colour);
    enqueue(r);
    String status = postBatch();
    if (qCount > BATCH_MAX && status.startsWith("sent")) status += " | " + postBatch();   // catch up

    char when[12] = "--:--:--";
    if (clockSet()) { time_t now = time(nullptr); struct tm t; localtime_r(&now, &t); strftime(when, sizeof when, "%H:%M:%S", &t); }
    Serial.printf("%s  pH %s", when, isnan(r.ph) ? "-" : String(r.ph, 2).c_str());
    if (HAS_TDS)  Serial.printf("  TDS %s", isnan(r.tds) ? "-" : String(r.tds, 0).c_str());
    if (HAS_TURB) Serial.printf("  NTU %s", isnan(r.turb) ? "-" : String(r.turb, 1).c_str());
    if (HAS_TEMP) Serial.printf("  %s C", isnan(r.temp) ? "-" : String(r.temp, 1).c_str());
    Serial.printf("  ->  %s %s%s  |  %s  (queue %d)\n", COLOURS[r.colour], LABELS[r.label],
                  treeState >= 0 ? " [tree]" : "", status.c_str(), qCount);
    if (status.startsWith("sent")) { statusLed(true); delay(60); statusLed(false); }
  }

  // Slow blink while offline, fast blink when the key is rejected.
  if (WiFi.status() != WL_CONNECTED || keyRejected) statusLed((millis() / (keyRejected ? 150 : 600)) % 2);
  delay(20);
}
